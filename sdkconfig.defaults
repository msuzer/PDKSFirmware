## sdkconfig.defaults
```kconfig
# ==============================
# FreeRTOS
# ==============================
CONFIG_FREERTOS_USE_TRACE_FACILITY=y
CONFIG_FREERTOS_GENERATE_RUN_TIME_STATS=y
CONFIG_FREERTOS_WATCHPOINT_END_OF_STACK=y

# ==============================
# Compiler / Build (RELEASE)
# ==============================
CONFIG_COMPILER_OPTIMIZATION_SIZE=y
CONFIG_COMPILER_OPTIMIZATION_DEBUG=n

# ==============================
# Logging
# ==============================
CONFIG_LOG_DEFAULT_LEVEL_INFO=y
CONFIG_LOG_MAXIMUM_LEVEL_INFO=y
CONFIG_LOG_COLORS=y
CONFIG_LOG_BOOTLOADER_LEVEL_NONE=y

# ==============================
# System
# ==============================
CONFIG_ESP_SYSTEM_PANIC_PRINT_REBOOT=y
CONFIG_ESP_TASK_WDT=y
CONFIG_ESP_TASK_WDT_TIMEOUT_S=5

# ==============================
# UART
# ==============================
CONFIG_ESP_CONSOLE_UART=y
CONFIG_ESP_CONSOLE_UART_NUM=0

# ==============================
# PSRAM (ESP32-S3 embedded)
# ==============================
CONFIG_SPIRAM=y
CONFIG_SPIRAM_MODE_OCT=y
CONFIG_SPIRAM_SPEED_80M=y

# ==============================
# FLASH
# ==============================
CONFIG_ESPTOOLPY_FLASHSIZE_16MB=y
CONFIG_ESPTOOLPY_HEADER_FLASHSIZE_UPDATE=y

# ==============================
# WiFi (TRIMMED)
# ==============================
CONFIG_ESP32_WIFI_SOFTAP=n
CONFIG_ESP32_WIFI_NAN_ENABLE=n
CONFIG_ESP_WIFI_ENABLE_WPA3_SAE=n
CONFIG_ESP_WIFI_ENABLE_WPA3_OWE=n
CONFIG_ESP_WIFI_ENABLE_WPA3_H2E=n

# ==============================
# lwIP (TRIMMED)
# ==============================
CONFIG_LWIP_IPV6=n
CONFIG_LWIP_STATS=n
CONFIG_LWIP_NETIF_STATUS_CALLBACK=n
CONFIG_LWIP_NETIF_LINK_CALLBACK=n

# ==============================
# TLS / mbedTLS (DISABLED FOR NOW)
# ==============================
# CONFIG_MBEDTLS_TLS_ENABLED=n
# CONFIG_MBEDTLS_SSL_PROTO_TLS1_2=n
# CONFIG_MBEDTLS_SSL_PROTO_TLS1_3=n

# ==============================
# Bluetooth (FULLY DISABLED)
# ==============================
CONFIG_BT_ENABLED=n
CONFIG_BLUEDROID_ENABLED=n
CONFIG_BT_NIMBLE_ENABLED=n
CONFIG_ESP_COEX_SW_COEXIST_ENABLE=n

# ==============================
# Ethernet
# ==============================
CONFIG_ETH_SPI_ETHERNET_W5500=y
CONFIG_ETH_SPI_ETHERNET=y
CONFIG_ETH_ENABLED=y
CONFIG_ESP_EVENT_LOOP_PROFILING=n   # optional, but fine

# ==============================
# Camera support (future)
# ==============================
CONFIG_ESP32S3_DATA_CACHE_64KB=y
CONFIG_ESP32S3_INSTRUCTION_CACHE_32KB=y
```
